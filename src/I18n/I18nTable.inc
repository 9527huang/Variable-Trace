/* Generated from tools/i18n/i18n_dict.json by tools/i18n/i18n_gen.py.
 *
 * Do not edit: change the dictionary and run the generator, or the table and
 * the dictionary drift apart and the difference is invisible at run time,
 * because a missing entry leaves the English in place.
 *
 * The entries are sorted by the English text, which is the order the lookup
 * bisects.
 */
static const Entry table[] = {
	{" plot image.", " 张图片。"},
	{" plot images.", " 张图片。"},
	{"%.4g s per sample (%.4g Hz)", "%.4g 秒/采样 (%.4g Hz)"},
	{"%d of the %d tasks the window knows about could be measured, over the last %.2f s.", "窗口见过的 %d 个任务里有 %d 个测得到,窗口长度为最近 %.2f 秒。"},
	{"%u samples, %.2f s apart, %u unread", "%u 个采样,间隔 %.2f 秒,%u 处没读到"},
	{"%u samples, %u unread", "%u 个采样,%u 处没读到"},
	{"%u samples, one every %s", "%u 个采样，间隔 %s"},
	{"%u tasks", "任务 %u 个"},
	{"%u variables, %u bytes", "%u 个变量，%u 字节"},
	{"%u%% of this stack is still free, at or below the alert threshold of %u%%.", "这个栈还有 %u%% 空闲,已达到或低于 %u%% 的告警阈值。"},
	{"%zu %s to save", "%zu 个%s待保存"},
	{"' waits for a trigger. Pick a source variable below first.", "」需要触发。请先在下方选择触发源变量。"},
	{"(%zu earlier lines were dropped)", "（已丢弃较早的 %zu 行）"},
	{"(no label)", "（无标签）"},
	{"(no output)", "（无输出）"},
	{"(the last %zu lines are kept)", "（仅保留最后 %zu 行）"},
	{"(the variable this plan is for)", "（本计划针对的变量）"},
	{"*.elf/*.axf file:", "*.elf/*.axf 文件:"},
	{"*.elf/*.axf parser:", "*.elf/*.axf 解析器:"},
	{"- the round did not read that task, which is not the same as idle", "——那一轮没读到这个任务,不等于它空闲"},
	{"<multiple vars>", "<多个变量>"},
	{"A few tasks are scanned per round, so the readings are not all from the same moment. A reading marked with a leading <= stopped at the scan limit, so the used part is at most what it says.", "每轮只扫几个任务,所以这些读数并非取自同一时刻。前面带 <= 的读数在扫描上限处停下,因此已用部分至多为该值。"},
	{"A flash is already in progress.", "烧录已在进行中。"},
	{"A flash is in progress. See the Flash Output window.", "正在烧录。请查看烧录输出窗口。"},
	{"A local HTTP endpoint that exposes the project, the variable table and the acquisition as tools. The server listens on the loopback interface only. It is off until it is switched on here.", "一个本地 HTTP 接口，把工程、变量表与采集作为工具暴露出来。服务器只监听回环接口。只有在这里打开之后它才会启动。"},
	{"A plain TCP line protocol for callers that cannot speak HTTP, such as a PLC or a console script. Each line is one JSON request naming a tool; each reply is one JSON line. It runs the same tools as the API server.", "面向无法使用 HTTP 的调用方的纯 TCP 行协议,例如 PLC 或控制台脚本。每行是一次 JSON 请求,指明要调用的工具;每次回复是一行 JSON。它运行的工具与 API 服务相同。"},
	{"A plan with that name already exists!", "已存在同名计划！"},
	{"A probe reached this way is picked by its address instead of by its serial number.", "这样连接的探针按地址选取,不再按序列号。"},
	{"A round that could not read one of the kernel's lists leaves its tasks out of that sample. The gap is not a task that was idle.", "某一轮读不到内核的某张链表时,表上的任务就不在这个采样里。那个空档不是「任务空闲」。"},
	{"A step holds its value until the next step begins.", "每一步保持其数值，直到下一步开始。"},
	{"A task whose current priority is above its base one is holding a lock that a higher priority task is waiting for.", "当前优先级高于基础优先级的任务,正持有一个更高优先级任务在等的锁。"},
	{"A task whose stack is this empty or less is marked. Zero turns the marking off, and a task with no reading is never marked.", "栈剩余空间小于等于该百分比的任务会被标记。填 0 关闭标记;没有读数(没扫到)的任务永远不会被标记。"},
	{"A variable worked out from another one has no bytes of its own on the target, so the recorder cannot compare it. Add a plain variable to the group to trigger on it.", "由其他变量算出的变量在目标上没有自己的字节，记录器无法比较它。请在组里加入一个普通变量作为触发源。"},
	{"API server", "API 服务"},
	{"Abort", "中止"},
	{"Abort##testFlashAbort", "中止##testFlashAbort"},
	{"About", "关于"},
	{"Acquisition settings...", "采集设置..."},
	{"Acqusition Settings", "采集设置"},
	{"Add", "添加"},
	{"Add a group of type 'recorder' in the plot tree and make it the active one.", "在绘图树中新建一个「记录器」类型的组，并把它设为活动组。"},
	{"Add plan", "添加计划"},
	{"Add variable", "添加变量"},
	{"Address", "地址"},
	{"Address fragmentation", "地址碎片"},
	{"Address of the machine running the GDB server. OpenOCD, and the servers shipped with probes, both speak the protocol this reads through.", "运行 GDB 服务器那台机器的地址。OpenOCD 与各家探针自带的服务器都说这套协议,本软件就是通过它读内存的。"},
	{"Advanced", "高级"},
	{"All files", "所有文件"},
	{"Allow API writes to the target", "允许 API 写入目标"},
	{"Appearance", "外观"},
	{"Applies to the whole interface, including the plots.", "作用于整个界面，包括绘图区。"},
	{"Applies to the whole interface. The panels keep their places.", "作用于整个界面。各面板保留原来的位置。"},
	{"Applies transformation [(value >> shift) & mask] after sampling and before interpretation.", "在采样之后、解释之前应用变换 [(value >> shift) & mask]。"},
	{"Ask for location:##askForScreenshotLocation", "每次询问位置:##askForScreenshotLocation"},
	{"Auto-detected from the TI C2000 code generation tools / Code Composer Studio install. Override here if not found automatically.", "自动从 TI C2000 代码生成工具 / Code Composer Studio 的安装目录中查找。未能自动找到时，在此手动指定。"},
	{"Autosave project", "自动保存工程"},
	{"Back to live", "回到实时"},
	{"Bar", "柱状图"},
	{"Baudrate", "波特率"},
	{"Baudrate:", "波特率:"},
	{"Bottleneck", "性能瓶颈"},
	{"Buffer wait", "缓冲区等待"},
	{"C2000 Target Detected", "检测到 C2000 目标"},
	{"CPU", "CPU 占用"},
	{"CSV active", "CSV 正在记录"},
	{"CSV backlog", "CSV 积压"},
	{"CSV idle", "CSV 空闲"},
	{"CSV queue", "CSV 队列"},
	{"CSV status", "CSV 状态"},
	{"CSV stopped", "CSV 已停止"},
	{"Cancel", "取消"},
	{"Capture", "捕获"},
	{"Change to other GDB variant if needed. Given program will be run to update variables addresses.", "如有需要可改用其他 GDB 版本。所填程序会被运行，用于更新变量地址。"},
	{"Channels", "通道"},
	{"Check if the variable address and size should be automatically updated from *.elf/*.axf file.", "选择是否从 *.elf/*.axf 文件自动更新变量地址与大小。"},
	{"Check if you'd like to specify a different variable name that will be sampled.", "选择是否另行指定一个用于采样的变量名。"},
	{"Chinese", "中文"},
	{"Choose the ELF parser.", "选择 ELF 解析器。"},
	{"Clear list", "清空列表"},
	{"Click the button above to test the flash command.", "点击上方按钮测试烧录命令。"},
	{"Click to open the acquisition settings.", "点击打开采集设置。"},
	{"Click to reload *.elf/*.axf changes!", "点击重新加载 *.elf/*.axf 的变更！"},
	{"Command channel", "命令通道"},
	{"Connected", "已连接"},
	{"Connecting", "连接中"},
	{"Connection:", "连接方式:"},
	{"Copies the whole buffer out of the target and rebuilds the samples from the ring state. The sampling loop pauses for the duration of the copy.", "把整个缓冲区从目标读出，并依据环形状态重建采样。复制期间采样循环会暂停。"},
	{"Copy", "复制"},
	{"Copy to recorder group", "复制到记录器组"},
	{"Copy to sampling group", "复制到采样组"},
	{"Cursors:", "光标:"},
	{"Curve", "曲线"},
	{"Deadline limited", "期限受限"},
	{"Deadline misses", "期限丢失"},
	{"Debug Probe", "调试器"},
	{"Debug probe S/N:", "调试器序列号:"},
	{"Debug probe, SWD speed and Target name here drive the RAM variable acquisition.", "这里的调试器、SWD 速度与目标名称驱动 RAM 变量采集。"},
	{"Debug probe, SWD speed and Target name here drive the SWO trace acquisition only.", "这里的调试器、SWD 速度与目标名称只驱动 SWO 跟踪采集。"},
	{"Debug probe:", "调试器:"},
	{"Del", "删除"},
	{"Delete", "删除"},
	{"Delete group", "删除组"},
	{"Delete plot", "删除图"},
	{"Delete var", "删除变量"},
	{"Detect", "检测"},
	{"Disabled", "已关闭"},
	{"Disconnected", "未连接"},
	{"Disconnecting", "断开中"},
	{"Do you want to save the current config?\n", "是否保存当前配置？\n"},
	{"Done", "完成"},
	{"Download", "下载"},
	{"Edge:", "边沿:"},
	{"Either type a new base (multiplier), or select a variable defined as base from the list of imported variables.", "可以直接输入新的基数（乘数），也可以从已导入变量中选一个被定义为基数的变量。"},
	{"Elf files", "符号文件"},
	{"Empty means the directory the program was started from.", "留空表示程序启动时所在的目录。"},
	{"Enable MCP server##mcp", "启用 MCP 服务##mcp"},
	{"Enable command channel##command", "启用命令通道##command"},
	{"Enable recorder", "启用记录器"},
	{"English", "English"},
	{"Error", "错误"},
	{"Error!", "错误！"},
	{"Export directory:##screenshotDialogDirectory", "导出目录:##screenshotDialogDirectory"},
	{"Export directory:##screenshotDirectory", "导出目录:##screenshotDirectory"},
	{"Export plot to *.csv", "导出绘图到 *.csv"},
	{"Failed", "写入失败"},
	{"Failed to save plot image to: ", "图像保存失败，路径: "},
	{"Failed to save plot image: file handler is not available for Save As dialog.", "无法保存图像：另存为对话框的文件处理不可用。"},
	{"Failed to save plot image: invalid screenshot data returned by renderer.", "无法保存图像：渲染器返回了无效的截图数据。"},
	{"Failure time:", "失败时间:"},
	{"File", "文件"},
	{"File name:##screenshotDialogFileName", "文件名:##screenshotDialogFileName"},
	{"File name:##screenshotFileName", "文件名:##screenshotFileName"},
	{"File open failed", "文件打开失败"},
	{"File write failed", "文件写入失败"},
	{"Firmware file:", "固件文件:"},
	{"Flash", "烧录"},
	{"Flash Output", "烧录输出"},
	{"Flash command output:", "烧录命令输出:"},
	{"Flash command:", "烧录命令:"},
	{"Flash successful!", "烧录成功！"},
	{"Flashing", "烧录"},
	{"Flashing Settings", "烧录设置"},
	{"Flashing in progress...", "正在烧录..."},
	{"GDB command:", "GDB 命令:"},
	{"GDB server", "GDB 服务器"},
	{"GDB server:", "GDB 服务器:"},
	{"GDB: reliable, default. DWARF: faster variable address updates (beta). C2000: for TI C2000 targets, uses ofd2000.", "GDB: 稳定可靠，默认。DWARF: 变量地址更新更快（测试版）。C2000: 面向 TI C2000 目标，使用 ofd2000。"},
	{"General", "通用"},
	{"Group", "组"},
	{"Group Edit", "编辑组"},
	{"Group already exists!", "组已存在！"},
	{"Group: %s", "组: %s"},
	{"Help", "帮助"},
	{"How many seconds of history to show.", "显示多少秒的历史。"},
	{"How much time the viewport shows while acquisition is running. What can be shown is bounded by the samples that are kept: Max points at the sampling frequency.", "采集时视窗显示多长一段时间。真正能显示多少由保留下来的样本决定，也就是 Max points 除以采样率。"},
	{"How the J-Link is reached: over USB, or over the network at the address below.", "J-Link 怎么连:USB,或者走网络并用下面的地址。"},
	{"IP address:", "IP 地址:"},
	{"If the port is taken, the next free one is used.", "端口被占用时，改用下一个空闲端口。"},
	{"Import Variables", "导入变量"},
	{"Import feature is still in Beta. If you're unable to find your variable on the list please open an issue on GitHub (remember to attach your *.elf/*.axf file).", "导入功能仍处于测试阶段。如果在列表里找不到你的变量，请在 GitHub 上提一个 issue（记得附上你的 *.elf/*.axf 文件）。"},
	{"Import variables from *.elf/*.axf", "从 *.elf/*.axf 导入变量"},
	{"Increment file name is off, so every plot is written to the same file and the last one is the one that survives.", "文件名递增已关闭，因此每张图都写入同一个文件，只有最后一张会保留。"},
	{"Increment file name:##incrementFileName", "文件名递增:##incrementFileName"},
	{"Increment file name:##screenshotDialogIncrement", "文件名递增:##screenshotDialogIncrement"},
	{"Indicators", "指示器"},
	{"Indicators help to ascess the quality of trace waveforms. Look out for red indicators that tell you a frame might be misinterpreted. In such cases try to increase the trace prescaler or limit the number of active trace channels.", "指示器用于评估跟踪波形的质量。出现红色指示器说明某一帧可能被错误解析，此时可以试着提高跟踪预分频，或减少启用的跟踪通道数量。"},
	{"Info", "提示"},
	{"Interpret integer numbers as fixed point variables.", "把整数按定点数解释。"},
	{"Interpretation", "解释"},
	{"It is highly recommended to switch to the C2000 parser", "强烈建议切换到 C2000 解析器"},
	{"JLink script:", "J-Link 脚本:"},
	{"Keep connection:", "保持连接:"},
	{"Keep current parser", "保留当前解析器"},
	{"Keeps the connection to the probe open when a run ends. Closing it halts the target on some setups, and that halt is what the next run has to undo before it can read anything.", "停止采集后不关闭与探针的连接。部分目标在关闭连接时会把内核停住，而那个停顿正是下一次采集要先解开的。"},
	{"Label", "标签"},
	{"Label already exists!", "标签已存在！"},
	{"Label cannot be empty!", "标签不能为空！"},
	{"Language##language", "语言##language"},
	{"Legacy project could not be read!", "旧版工程无法读取！"},
	{"Legacy project imported. Use Save to store it as .mcvproj.", "旧版工程已导入。使用「保存」把它存为 .mcvproj。"},
	{"Legacy projects", "旧版工程"},
	{"License", "许可证"},
	{"Line speed of the serial port. It has to match the baud rate the target firmware configures for its UART.", "串口的线路速率，必须与目标固件为其 UART 配置的波特率一致。"},
	{"Listening on %s", "正在监听 %s"},
	{"Listening on %s (%zu tools)", "正在监听 %s（%zu 个工具）"},
	{"Log all registered variables values to a selected log directory. File is created automatically and overwritten on each start.", "把所有已注册变量的数值记录到指定目录。文件会自动创建，并在每次开始采集时覆盖。"},
	{"Log to file:", "记录到文件:"},
	{"Logfile directory:", "日志目录:"},
	{"Logging", "日志记录"},
	{"Max points used for a single series after which the oldest points will be overwritten.", "单条曲线的最大点数，超出后最早的点会被覆盖。"},
	{"Max points used for a single series that will be shown in the viewport without scroling.", "单条曲线在视口中直接显示、不滚动的最大点数。"},
	{"Max points:", "最大点数:"},
	{"Max value cannot be less than min value!", "最大值不能小于最小值！"},
	{"Max view points:", "视口最大点数:"},
	{"Maximum sampling frequency. Depending on the used debug probe it can be reached or not.", "最高采样频率。能否达到取决于所用的调试器。"},
	{"Min value cannot be greater than max value!", "最小值不能大于最大值！"},
	{"Mode", "模式"},
	{"Mode '", "模式「"},
	{"Mode:", "模式:"},
	{"NORMAL", "普通"},
	{"NOT FOUND!", "未找到！"},
	{"NOT FOUND. Please set the ofd2000 path manually", "未找到。请手动设置 ofd2000 路径"},
	{"Name", "名称"},
	{"Name has to be unique - it can be different from tracked variable name if you specify it manually below.", "名称必须唯一。如果在下面手动指定，它可以与跟踪的变量名不同。"},
	{"Name the values this variable can take. A value without a name is shown as a number.", "为该变量可能的取值命名。没有命名的取值会以数字显示。"},
	{"Needs the API server to be enabled.", "需要先启用 API 服务。"},
	{"New", "新建"},
	{"No", "否"},
	{"No GDB server address, the acquisition cannot connect without one.", "没有填 GDB 服务器地址,采集无法连接。"},
	{"No bottleneck", "无性能瓶颈"},
	{"No debug probes found!", "未找到调试器！"},
	{"No device was picked in the J-Link dialog, the current Target name was kept.", "J-Link 对话框中没有选择器件，保留了当前的目标名称。"},
	{"No firmware file configured. Provide 'file' or set it in Options -> Flashing.", "未配置固件文件。请提供 file 参数或在「选项 -> 烧录」中设置。"},
	{"No plan selected", "未选择计划"},
	{"No plot selected", "未选择图"},
	{"No samples were lost.", "没有样本丢失。"},
	{"No tasks in this round.", "这一轮里没有任务。"},
	{"No variable of this group can be a trigger source.", "本组中没有变量可以作为触发源。"},
	{"No visible plot to save.", "没有可见的图可以保存。"},
	{"Not available", "不可用"},
	{"Not detected yet.", "尚未检测到。"},
	{"Not listening: %s", "未在监听: %s"},
	{"Not tested", "未测试"},
	{"Nothing was published in this window.", "这个窗口里没有已发布的快照。"},
	{"OK", "确定"},
	{"Older samples were overwritten before the copy.", "复制之前较早的样本已被覆盖。"},
	{"One mark is one round, not an interval: what was true at that instant, and nothing about the time between two of them.", "一个标记就是一轮,不是一段区间:它只说明那一刻为真,两轮之间的事一概不知道。"},
	{"Open", "打开"},
	{"Open Recent", "最近打开"},
	{"Options", "选项"},
	{"PNG image (*.png)", "PNG 图像 (*.png)"},
	{"Peak", "峰值"},
	{"Plans", "计划"},
	{"Please enable recorder in Acquisition settings to add a new recorder group", "请先在采集设置中启用记录器，才能新建记录器组"},
	{"Please enable recorder in Acquisition settings to copy this group to a recorder group", "请先在采集设置中启用记录器，才能把该组复制为记录器组"},
	{"Plot", "图"},
	{"Plot Edit", "编辑图"},
	{"Plot Tree", "绘图树"},
	{"Plot already exists!", "图已存在！"},
	{"Plot export", "绘图导出"},
	{"Plot image save canceled.", "已取消保存图像。"},
	{"Plots", "绘图"},
	{"Port", "端口"},
	{"Port the GDB server serves on. OpenOCD's default is 3333.", "GDB 服务器提供服务的端口。OpenOCD 默认是 3333。"},
	{"Port:", "端口:"},
	{"Postprocessing", "后处理"},
	{"Pre-trigger:", "预触发:"},
	{"Preferences", "偏好设置"},
	{"Probe", "调试器"},
	{"Probe latency", "探针延迟"},
	{"Probe time", "探针耗时"},
	{"Project", "工程"},
	{"Project could not be saved!", "工程未能保存！"},
	{"Project files", "工程文件"},
	{"Properties", "属性"},
	{"Queue", "队列"},
	{"Queue overload", "队列过载"},
	{"Queue:", "队列:"},
	{"Quit", "退出"},
	{"RUNNING", "运行中"},
	{"Rate attained", "速率达成"},
	{"Read over %.1f ms; %d place(s) caught the target moving, so the parts of this table are not all from one moment.", "读取历时 %.1f 毫秒;有 %d 处读到目标正在变动,这张表各部分并非取自同一时刻。"},
	{"Read over %.1f ms; %d place(s) caught the target moving.", "读取历时 %.1f 毫秒;有 %d 处读到目标正在变动。"},
	{"Read over %.1f ms; every kernel list held together.", "读取历时 %.1f 毫秒;每个内核链表都前后一致。"},
	{"Read value", "读取值"},
	{"Reason", "原因"},
	{"Reason:", "原因:"},
	{"Recorder", "记录器"},
	{"Recorder detected.", "已检测到记录器。"},
	{"Recorder detected. %s.", "已检测到记录器。%s。"},
	{"Recorder group", "记录器组"},
	{"Recording. The target fills its buffer on its own, press Download when it has filled.", "正在记录。目标自行填充缓冲区，填满后按「下载」。"},
	{"Refresh", "刷新"},
	{"Refresh vars on *.elf/*.axf change:", "*.elf/*.axf 变更时刷新变量:"},
	{"Rejected", "已拒绝"},
	{"Releases", "版本发布"},
	{"Render contention", "绘图争用"},
	{"Requested / actual", "请求 / 实际"},
	{"Restarted with the new %s.", "已按新的 %s 重新启动。"},
	{"Run captures continuously and keeps the newest samples. Normal and single wait for the trigger; single stops after one capture, normal can be started again.", "连续模式持续采集并保留最新采样。普通与单次模式等待触发；单次模式捕获一次后停止，普通模式可以再次启动。"},
	{"Runs a J-Link script of your own before the target is connected - for targets that need a watchdog stopped or a reset in a particular order.", "连接目标之前先运行一份自己的 J-Link 脚本——有些目标需要先关看门狗,或者按特定顺序复位。"},
	{"Runs the flash command from Options -> Flashing on the firmware file.", "对固件文件运行「选项 -> 烧录」中的烧录命令。"},
	{"STOPPED", "已停止"},
	{"SWD speed", "SWD 速度"},
	{"SWD speed [kHz]:", "SWD 速度 [kHz]:"},
	{"Sample:", "采样值:"},
	{"Samples kept from before the trigger. The captured window always ends at the trigger plus this many samples.", "触发前保留的采样数。采集窗口总是结束于触发点之后这么多采样。"},
	{"Samples:", "样本:"},
	{"Sampling [Hz]:", "采样率 [Hz]:"},
	{"Sampling group", "采样组"},
	{"Save", "保存"},
	{"Save As..", "另存为.."},
	{"Save Plots", "保存绘图"},
	{"Save Plots to *.png", "保存绘图为 *.png"},
	{"Save?", "保存？"},
	{"SaveOnNew?", "新建前保存？"},
	{"Saved ", "已保存 "},
	{"Saves the project file when it is modified and has a path.", "当工程已修改且已有路径时，自动保存工程文件。"},
	{"Saving successful!", "保存成功！"},
	{"Scanned on this side over %d task(s); the oldest reading is %.1f s old.", "本机侧扫描,覆盖 %d 个任务;最旧的读数已过 %.1f 秒。"},
	{"Select Variables", "选择变量"},
	{"Select a plan to edit", "选择要编辑的计划"},
	{"Select firmware file and flash command to use for flashing.", "选择用于烧录的固件文件与烧录命令。"},
	{"Select normal or high speed sampling (HSS) mode", "选择普通或高速采样（HSS）模式"},
	{"Select or type an imported variable name from the *.elf/*.axf file.", "从 *.elf/*.axf 文件中选择或输入一个已导入的变量名。"},
	{"Select range:", "选择区间:"},
	{"Select the debug probe type and the serial number of the probe to unlock the START button.", "选择调试器类型与序列号，START 按钮才会可用。"},
	{"Select your *.elf/*.axf file in the Options->Acqusition Settings to import or update the variables.", "请在 选项->采集设置 中选择 *.elf/*.axf 文件，以导入或更新变量。"},
	{"Selected file path replaces the {file} macro in the flash command below.", "所选文件路径会替换下方烧录命令中的 {file} 宏。"},
	{"Selected path contains spaces!", "所选路径包含空格！"},
	{"Serial number", "序列号"},
	{"Serial port", "串口"},
	{"Serial port:", "串口:"},
	{"Set a flash command above first.", "请先在上方设置烧录命令。"},
	{"Set a flash command in Options -> Flashing.", "请在「选项 -> 烧录」中设置烧录命令。"},
	{"Settings", "设置"},
	{"Share of the time the kernel counted across all tasks over the last %.2f s.", "在所有任务被计到的时间里的占比,窗口为最近 %.2f 秒。"},
	{"Skip samples:", "跳过采样:"},
	{"Source", "源码"},
	{"Source:", "来源:"},
	{"Stack used", "栈占用"},
	{"Start", "开始"},
	{"State", "状态"},
	{"Statistics", "统计"},
	{"Statistics:", "统计:"},
	{"Status:", "状态:"},
	{"Steps", "步骤"},
	{"Stop", "停止"},
	{"Stop on *.elf/*.axf change:", "*.elf/*.axf 变更时停止:"},
	{"Support <3", "支持 <3"},
	{"Switch to C2000 parser (recommended)", "切换到 C2000 解析器（推荐）"},
	{"Table", "表格"},
	{"Target", "目标"},
	{"Target name", "目标名称"},
	{"Target name is empty, the J-Link cannot connect. Enter the device name, e.g. STM32F103C8.", "目标名称为空，J-Link 无法连接。请输入器件名称，例如 STM32F103C8。"},
	{"Target name:", "目标名称:"},
	{"Task Viewer", "任务查看器"},
	{"Test flash", "测试烧录"},
	{"Test output:", "测试输出:"},
	{"The *.png extension is added when it is missing.", "缺少 *.png 扩展名时会自动补上。"},
	{"The acquisition is stopped. Start it first, the recorder uses that connection.", "采集已停止。请先启动采集，记录器要使用那条连接。"},
	{"The capture start did not sit on a sample boundary, so it was moved down to the nearest one.", "捕获起点未落在样本边界上，已向下移动到最近的边界。"},
	{"The following variables were already imported: \n", "以下变量已经导入过：\n"},
	{"The mark is on the used part, which is what the row shows.", "标记在已用部分上,那是这一行显示的数字。"},
	{"The path replaces every {file} in the command. Without one it is appended at the end.", "该路径会替换命令中所有 {file}。命令里没有 {file} 时，追加到末尾。"},
	{"The percentage of trace time visible during collect. Expressed in percent since the sample period is not constant.", "采集时可见的跟踪时间占比。由于采样周期不固定，以百分比表示。"},
	{"The recorder could not be restarted: ", "记录器无法重新启动: "},
	{"The recorder is not available in this build.", "此构建中没有记录器。"},
	{"The recorder samples inside a timer interrupt on the target and keeps the samples in its own memory. Nothing is streamed while it runs.", "记录器在目标的定时器中断里采样，并把采样保存在自己的内存中，运行期间不做任何流式传输。"},
	{"The recorder was disabled and the target was stopped.", "记录器已关闭，目标已停止。"},
	{"The recorder was disabled, but the target could not be stopped: ", "记录器已关闭，但目标无法停止: "},
	{"The run time counter did not move over the last window, so the shares cannot be worked out. The timer behind it is probably not running.", "运行时间计数器在上一个窗口里没有变化,因此算不出占比。它背后的定时器很可能没有运行。"},
	{"The selected file appears to be a TI C2000 target binary.", "所选文件看起来是 TI C2000 目标二进制。"},
	{"The server could not be started: ", "服务器无法启动: "},
	{"The shares are of the time those tasks used. A task the round could not read has no counter to add to the whole, and time the kernel attributes to no task - the interrupts mostly - was never in it.", "占比是这些任务用掉的时间里的份额。本轮读不到的任务没有计数器可以加进总数,而内核不计到任何任务上的时间(主要是中断)本来就不在里面。"},
	{"The symbol table has no ____recorderSettings or ____recorder. Import the variables from an *.elf/*.axf built with the recorder sources.", "符号表中没有 ____recorderSettings 或 ____recorder。请从按记录器源变量构建的 *.elf/*.axf 导入变量。"},
	{"The target does not fill its stacks, so how much of one is used cannot be worked out. FreeRTOS fills them when configCHECK_FOR_STACK_OVERFLOW is above 1, or configUSE_TRACE_FACILITY, or INCLUDE_uxTaskGetStackHighWaterMark, or INCLUDE_uxTaskGetStackHighWaterMark2 is set.", "目标没有填充栈,因此算不出每个栈用了多少。FreeRTOS 在下面任一条件成立时会填充:configCHECK_FOR_STACK_OVERFLOW 大于 1、configUSE_TRACE_FACILITY、INCLUDE_uxTaskGetStackHighWaterMark、INCLUDE_uxTaskGetStackHighWaterMark2。"},
	{"The target is idle.", "目标空闲。"},
	{"The target is sampling.", "目标正在采样。"},
	{"The target was not built with run time statistics (configGENERATE_RUN_TIME_STATS), so how much of the time each task used cannot be worked out.", "目标没有启用运行时间统计(configGENERATE_RUN_TIME_STATS),因此算不出每个任务占用了多少时间。"},
	{"The target was stopped.", "目标已停止。"},
	{"The task on the right is running above the priority it was created with, which the kernel only does while a higher priority task waits for a lock it holds. The lock is how long it has been held.", "右边那个任务正以高于创建时的优先级运行,内核只在有更高优先级任务等它持的锁时这样做。这把锁就是它持有了多久。"},
	{"The timeline fills up as rounds are published.", "时间线随快照发布逐步填满。"},
	{"The trigger has fired.", "触发已发生。"},
	{"Theme##theme", "主题##theme"},
	{"There is no active recorder group.", "没有活动的记录器组。"},
	{"These settings belong to the TRACE VIEWER", "这些设置属于跟踪查看器"},
	{"These settings belong to the VARIABLE VIEWER", "这些设置属于变量查看器"},
	{"This build was compiled without the DWARF library, so this parser cannot read a file.", "此构建编译时未包含 DWARF 库，该解析器无法读取文件。"},
	{"Time", "时间"},
	{"Time base unknown until the recorder is detected.", "在检测到记录器之前，时基未知。"},
	{"Time the kernel attributes to no task, the interrupts mostly, is not part of the whole.", "内核不计到任何任务上的时间(主要是中断)不在这个总数里。"},
	{"Time##add", "时间##add"},
	{"Timeline", "时间线"},
	{"Timeout [s]:", "超时 [s]:"},
	{"Timeout is the period after which trace will be stopped due to no trace data being received.", "超过这段时间没有收到跟踪数据，跟踪就会被停止。"},
	{"Trace Plots", "跟踪绘图"},
	{"Trace Viewer", "跟踪查看器"},
	{"Trace Viewer acquisition", "跟踪查看器采集"},
	{"Tracked variable doesn't exist!", "被跟踪的变量不存在！"},
	{"Trigger", "触发"},
	{"Two or more tasks are each waiting for a lock the next one holds. A round is a sample: if the ring clears between two of them it leaves no trace, which is why this is suspected rather than proven.", "两个或更多任务各自在等下一个任务手里的锁。一轮只是一个采样:环若在两轮之间自行解开就不留痕迹,所以说疑似而不说确证。"},
	{"Type", "类型"},
	{"Uncheck a channel to disable it and free some of the SWO pin bandwidth.", "取消勾选某个通道即可停用它，释放一部分 SWO 引脚带宽。"},
	{"Update error. Please check the *.elf/*.axf file path!", "更新出错。请检查 *.elf/*.axf 文件路径！"},
	{"Update variable addresses", "更新变量地址"},
	{"Use *.elf/*.axf file:", "使用 *.elf/*.axf 文件:"},
	{"User Guide", "用户指南"},
	{"Value", "数值"},
	{"Value must be a valid integer!", "数值必须是有效的整数！"},
	{"Value##add", "数值##add"},
	{"Value:", "数值:"},
	{"Var Viewer", "变量查看器"},
	{"Variable Edit", "编辑变量"},
	{"Variable Viewer acquisition", "变量查看器采集"},
	{"Variable already exists!", "变量已存在！"},
	{"Variable-Trace", "Variable-Trace"},
	{"Variable-Trace | ", "Variable-Trace | "},
	{"Variables", "变量"},
	{"Version %u.%u, time base %u ns, buffer %u elements, up to %u variables, float %s", "版本 %u.%u，时基 %u ns，缓冲区 %u 个元素，最多 %u 个变量，浮点 %s"},
	{"Viewport width [%%]:", "视口宽度 [%%]:"},
	{"Viewport width [ms]:", "视窗宽度 [毫秒]:"},
	{"Waiting for trigger...", "正在等待触发……"},
	{"Warming up", "正在预热"},
	{"Warning!", "警告！"},
	{"When checked, {file} is replaced with the *.elf/*.axf path set in Options -> Acquisition.", "勾选后，{file} 会被 选项 -> 采集 中设置的 *.elf/*.axf 路径替换。"},
	{"When enabled, each screenshot opens a Save As dialog of its own and the two fields below are only what it starts from.", "启用后，每次截图都会单独弹出另存为对话框，下面两项只是它的初始值。"},
	{"When enabled, flashing will be aborted automatically if there is no output for the specified time.", "启用后，若在设定时间内没有任何输出，烧录会被自动中止。"},
	{"When enabled, writing values outside the specified range will be rejected.", "启用后，写入超出指定范围的数值会被拒绝。"},
	{"Window", "窗口"},
	{"With several plots, numbers each file so none is written over.", "有多个绘图时，为每个文件编号，避免互相覆盖。"},
	{"Without this, set_variable_value is refused. Each variable can carry its own min/max range on top.", "不启用时，set_variable_value 会被拒绝。此外每个变量还可以各自设置最小/最大范围。"},
	{"Write Planner", "写计划器"},
	{"Write value", "写入值"},
	{"Written", "已写入"},
	{"X-axis label:", "X 轴标签:"},
	{"X-axis variable:", "X 轴变量:"},
	{"XY", "XY"},
	{"Y-axis label:", "Y 轴标签:"},
	{"Yes", "是"},
	{"a cursor in the variable view", "变量视图里的光标"},
	{"a modified version of MCUViewer 1.1.0, under the GPLv3", "MCUViewer 1.1.0 的修改版,以 GPLv3 分发"},
	{"address:", "地址:"},
	{"alias", "别名"},
	{"analog", "模拟"},
	{"and %zu more", "以及其他 %zu 项"},
	{"at", "时刻"},
	{"back to latest", "回到最新"},
	{"bar", "柱状图"},
	{"base type:", "基类型:"},
	{"base:", "基数:"},
	{"based on MCUViewer 1.1.0 (GPLv3)", "based on MCUViewer 1.1.0 (GPLv3)"},
	{"bin", "二进制"},
	{"blank", "空白"},
	{"blocked", "阻塞"},
	{"by Piotr Wasilewski (klonyyy)", "by Piotr Wasilewski (klonyyy)"},
	{"cannot open file", "无法打开文件"},
	{"clear filters", "清除筛选"},
	{"click a time to pin it", "点一下时间轴可钉住某一刻"},
	{"copy", "副本"},
	{"core frequency [kHz]", "核心频率 [kHz]"},
	{"created by a newer version", "由更新的版本创建"},
	{"curve", "曲线"},
	{"dec", "十进制"},
	{"delayed timestamp 1:    ", "延迟时间戳 1:"},
	{"delayed timestamp 2:    ", "延迟时间戳 2:"},
	{"delayed timestamp 3 in view:    ", "视野内延迟时间戳 3:"},
	{"delayed timestamp 3:    ", "延迟时间戳 3:"},
	{"deleted", "已删除"},
	{"delta (max-min):", "极差 (最大-最小):"},
	{"digital", "数字"},
	{"domain", "域"},
	{"error frames in view:   ", "视野内错误帧:"},
	{"error frames total:     ", "错误帧总数:"},
	{"falling", "下降沿"},
	{"fields:", "字段:"},
	{"filtered", "（已筛选）"},
	{"follow plot cursors", "跟随图光标"},
	{"following %u plot cursor(s)", "跟随 %u 个图光标"},
	{"font size", "字体大小"},
	{"fractional bits:", "小数位:"},
	{"frames total:           ", "帧总数:"},
	{"hex", "十六进制"},
	{"interval [s]", "间隔 [s]"},
	{"mask:", "掩码:"},
	{"max:", "最大:"},
	{"mean:", "平均:"},
	{"min:", "最小:"},
	{"name:", "名称:"},
	{"normal", "普通"},
	{"not a valid project file", "不是有效的工程文件"},
	{"not read", "个没读到"},
	{"ofd2000 executable", "ofd2000 可执行文件"},
	{"ofd2000 path:", "ofd2000 路径:"},
	{"ofd2000 status:", "ofd2000 状态:"},
	{"one mark per round", "每轮一个标记"},
	{"one mark per round, %.2f s apart", "每轮一个标记,间隔 %.2f 秒"},
	{"parent:", "父组:"},
	{"pending ready", "待就绪"},
	{"port##command", "端口##command"},
	{"port##mcp", "端口##mcp"},
	{"priority inheritance", "优先级继承"},
	{"priority inherited", "个优先级继承"},
	{"ready", "就绪"},
	{"reset sort", "重置排序"},
	{"rising", "上升沿"},
	{"run", "连续"},
	{"running", "运行"},
	{"runs from the target's switch records, %.0f s held", "区间来自目标的切换记录,保留 %.0f 秒"},
	{"sampling: %.2f Hz", "采样率: %.2f Hz"},
	{"sampling: 1000000.00 Hz", "采样率: 1000000.00 Hz"},
	{"script file:", "脚本文件:"},
	{"search", "搜索"},
	{"seconds back", "秒之前"},
	{"select...", "选择..."},
	{"shift right:", "右移:"},
	{"should reset", "复位条件"},
	{"single", "单次"},
	{"sleep cycles:           ", "休眠周期:"},
	{"specify tracked name:", "指定跟踪名:"},
	{"stack alert at", "栈告警阈值"},
	{"stack alerts", "个栈告警"},
	{"stack alerts only", "只看栈告警"},
	{"stddev:", "标准差:"},
	{"suspected deadlock", "疑似死锁"},
	{"suspended", "挂起"},
	{"table", "表格"},
	{"thin line", "细线"},
	{"time [s]", "时间 [s]"},
	{"time[s]", "时间[s]"},
	{"top level", "顶层"},
	{"trace prescaler", "跟踪预分频"},
	{"tracked variable:", "跟踪变量:"},
	{"trigger channel", "触发通道"},
	{"trigger level", "触发电平"},
	{"type", "类型"},
	{"type a name", "输入器件名"},
	{"type:", "类型:"},
	{"unknown", "未知"},
	{"unknown error", "未知错误"},
	{"unpin", "取消固定"},
	{"update from *.elf/*.axf:", "从 *.elf/*.axf 更新:"},
	{"value", "数值"},
	{"variable does not exist!", "变量不存在！"},
	{"variable:", "变量:"},
	{"version: ", "版本: "},
	{"visible plot", "张可见的图"},
	{"visible plots", "张可见的图"},
	{"write", "写入"},
	{"write limits:", "写入限制:"},
};
